## drivers/led/Kconfig.is31fl3242
```kconfig
# Copyright (c) 2023 Endor AG
# Copyright (c) 2024 Gerard Koskamp
# SPDX-License-Identifier: Apache-2.0

config IS31FL3242
	bool "IS31FL3242 LED driver"
	default y
	depends on DT_HAS_ISSI_IS31FL3242_ENABLED
	select I2C
	help
	  Enable LED driver for Lumissil Microsystems (a division of ISSI)
	  IS31FL3242. This chip supports up to 12 PWM controlled LEDs.
```

## dts/bindings/led/issi,is31fl3242.yaml
```yaml
# Copyright (c) 2023 Endor AG
# Copyright (c) 2024 Gerard Koskamp
# SPDX-License-Identifier: Apache-2.0

description: |
  is31fl3242 LED driver for Lumissil Microsystems (a division of ISSI)

compatible: "issi,is31fl3242"

include: i2c-device.yaml

properties:
  global-output-current:
    type: int
    default: 128
    description: Output current of white channel in 0.1875 mA (0-48 mA)
                 Default value is the power-on default. Valid range = 0 - 255
                 According to the datasheet this value should not be les then 32

  scaling-control:
    type: array
    default: [255, 255, 255, 255, 255, 255, 255, 255, 255, 255, 255, 255]
    description: This are the values set in the current scaling control registers
```
